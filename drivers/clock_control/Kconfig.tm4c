## drivers/clock_control/Kconfig.tm4c
```kconfig
config CLOCK_CONTROL_TM4C
	bool "TI TM4C clock control (RCGC/PR gating)"
	default y if SOC_FAMILY_TI_TM4C
	depends on CLOCK_CONTROL
	help
	  Enables peripheral clock gating control for TI TM4C MCUs using
	  SYSCTL RCGC* and PR* registers.
```

## dts/bindings/clock/ti,tm4c-clock.yaml
```yaml
# Copyright (c) 2025 Aeybel Varghese <aeybelvarghese@gmail.com>
#
# SPDX-License-Identifier: Apache-2.0

description: TI TM4C SYSCTL clock controller using per-peripheral RCGC*/PR* registers

compatible: "ti,tm4c-clock"

include:
  - clock-controller.yaml
  - base.yaml

properties:
  syscon:
    type: phandle
    required: true
    description: Phandle to the SYSCTL syscon node that contains the clock gating registers.

  clock-frequency:
    type: int
    description: System clock frequency in Hz (optional; used by get_rate()).

  "#clock-cells":
    const: 2

clock-cells:
  - offset
  - bit
```

## soc/ti/tm4c/Kconfig
```kconfig
# Copyright (c) 2025 Aeybel Varghese <aeybelvarghese@gmail.com>
#
# SPDX-License-Identifier: Apache-2.0

if SOC_FAMILY_TI_TM4C

rsource "*/Kconfig"

endif # SOC_FAMILY_TI_TM4C
```

## soc/ti/tm4c/Kconfig.soc
```kconfig
# Copyright (c) 2025 Aeybel Varghese <aeybelvarghese@gmail.com>
#
# SPDX-License-Identifier: Apache-2.0

config SOC_FAMILY_TI_TM4C
	bool

config SOC_FAMILY
	default "ti_tm4c" if SOC_FAMILY_TI_TM4C

rsource "*/Kconfig.soc"
```

## soc/ti/tm4c/tm4c123x/Kconfig
```kconfig
# Copyright (c) 2025 Aeybel Varghese <aeybelvarghese@gmail.com>
#
# SPDX-License-Identifier: Apache-2.0

config SOC_SERIES_TM4C123X
	select ARM
	select CPU_CORTEX_M4
	select CPU_CORTEX_M_HAS_SYSTICK
	select CPU_HAS_ARM_MPU
	select CPU_HAS_FPU
	select CPU_CORTEX_M_HAS_DWT
```

## soc/ti/tm4c/tm4c123x/Kconfig.defconfig
```kconfig
# Copyright (c) 2025 Aeybel Varghese <aeybelvarghese@gmail.com>
#
# SPDX-License-Identifier: Apache-2.0

if SOC_SERIES_TM4C123X

config NUM_IRQS
	default 139

config SYS_CLOCK_HW_CYCLES_PER_SEC
	default 16000000

if UART_STELLARIS

config UART_STELLARIS_PORT_0
	default y

endif # UART_STELLARIS

endif # SOC_SERIES_TM4C123X
```

## soc/ti/tm4c/tm4c123x/Kconfig.soc
```kconfig
# Copyright (c) 2025 Aeybel Varghese <aeybelvarghese@gmail.com>
#
# SPDX-License-Identifier: Apache-2.0

config SOC_SERIES_TM4C123X
	bool
	select SOC_FAMILY_TI_TM4C
	help
	  Enable support for Texas Instruments TM4C123x series SoCs

# ========== SOCS ==========

config SOC_TM4C123GH6PM
	bool
	select SOC_SERIES_TM4C123X

# ========== DEFAULTS ==========

config SOC_SERIES
	default "tm4c123x" if SOC_SERIES_TM4C123X

config SOC
	default "tm4c123gh6pm" if SOC_TM4C123GH6PM
```
